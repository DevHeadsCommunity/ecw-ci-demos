## app/testcase.yaml
```yaml
tests:
  ecw.ci_twister_test:
    platform_allow:
      - fpb_ra6e2
    tags:
      - ecw
      - hil
    harness: pytest
    timeout: 120
    harness_config:
      pytest_root:
        - pytest
```

## west.yml
```yaml
manifest:
  version: "0.13"
  projects:
    - name: zephyr
      url: https://github.com/zephyrproject-rtos/zephyr
      revision: 413b789deb391d3a37d06b463288a5fe765ee57e
      import:
        name-allowlist: [cmsis, cmsis_6, hal_renesas, picolibc]
  self:
    path: ecw-ci-demos
```
